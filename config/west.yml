## config/west.yml
```yaml
manifest:
  remotes:
    - name: bobobo1618
      url-base: https://github.com/bobobo1618
  projects:
    - name: zmk
      remote: bobobo1618
      revision: fix-oled 
      import: app/west.yml
  self:
    path: config
```
